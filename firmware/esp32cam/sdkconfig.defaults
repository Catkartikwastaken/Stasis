## firmware/esp32cam/src/Kconfig.projbuild
```kconfig
menu "STASIS Camera Configuration"

    config STASIS_WIFI_SSID
        string "WiFi SSID"
        default "STASIS_NET"
        help
            WiFi network name for MJPEG streaming.

    config STASIS_WIFI_PASS
        string "WiFi Password"
        default "stasis2024"
        help
            WiFi password for the STASIS network.

    config STASIS_WIFI_TIMEOUT_MS
        int "WiFi connection timeout (ms)"
        default 15000
        help
            Maximum time to wait for WiFi connection at boot.

    config STASIS_UART_BAUD
        int "UART baud rate"
        default 115200
        help
            Baud rate for UART communication to the ESP32-S3 main controller.

    config STASIS_STREAM_PORT
        int "HTTP stream server port"
        default 81
        help
            Port for MJPEG stream, single capture, and status endpoints.

    config STASIS_MOTION_PIXEL_THRESHOLD
        int "Motion detection pixel threshold"
        default 25
        help
            Minimum grayscale delta per pixel to count as changed (0-255).

    config STASIS_MOTION_PIXEL_RATIO
        int "Motion detection pixel ratio (x1000)"
        default 30
        help
            Percentage of changed pixels to trigger motion, multiplied by 1000.
            30 = 3.0% of sampled pixels must change.

    config STASIS_MOTION_SAMPLE_STEP
        int "Motion detection sample step"
        default 4
        range 1 16
        help
            Sample every Nth pixel for motion detection.
            Higher = faster but less accurate.

    config STASIS_FACE_SCORE_THRESHOLD
        int "Face detection score threshold (x100)"
        default 60
        help
            MTMN detection confidence threshold, multiplied by 100.
            60 = 0.60 confidence minimum.

    config STASIS_ALERT_CONFIDENCE
        int "Alert confidence threshold (x100)"
        default 72
        help
            Minimum face confidence to fire an alert, multiplied by 100.
            72 = 0.72 confidence.

    config STASIS_DETECT_COOLDOWN_MS
        int "Detection cooldown (ms)"
        default 30000
        help
            Time between alerts to prevent alert flooding.

    config STASIS_BUZZER_DURATION_MS
        int "Buzzer warning duration (ms)"
        default 500
        help
            How long the buzzer sounds after motion is detected.

    config STASIS_DETECT_TIMEOUT_MS
        int "Face detection timeout (ms)"
        default 8000
        help
            Maximum time to attempt face detection after motion trigger.

    config STASIS_STREAM_FPS_DELAY_MS
        int "Stream inter-frame delay (ms)"
        default 66
        help
            Delay between MJPEG frames. 66 = ~15 FPS.

    config STASIS_DEBUG_MODE
        bool "Enable debug logging"
        default n
        help
            Enable verbose detection state logging.

endmenu
```
